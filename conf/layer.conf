## conf/layer.conf
```bitbake
BBPATH .= ":${LAYERDIR}"

# We have a recipes directory containing .bb and .bbappend files, add to BBFILES
BBFILES += "${LAYERDIR}/recipes*/*/*.bb \
            ${LAYERDIR}/recipes*/*/*.bbappend"

BBFILE_COLLECTIONS += "fus-updater-azure"
BBFILE_PATTERN_fus-updater-azure := "^${LAYERDIR}/"

# Pri 16 ensures that our recipes are applied over other layers.
# This is applicable where we are using appends files to adjust other recipes.
BBFILE_PRIORITY_fus-updater-azure = "11"
LAYERDEPENDS_fus-updater-azure = "fus-updater"
LAYERSERIES_COMPAT_fus-updater-azure  = "zeus kirkstone"
```
